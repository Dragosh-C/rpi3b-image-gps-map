## yocto/conf/bblayers.conf
```bitbake
# POKY_BBLAYERS_CONF_VERSION is increased each time build/conf/bblayers.conf
# changes incompatibly
POKY_BBLAYERS_CONF_VERSION = "2"

BBPATH = "${TOPDIR}"
BBFILES ?= ""

BBLAYERS ?= " \
  /home/dragos/learnin/yocto/poky/meta \
  /home/dragos/learnin/yocto/poky/meta-poky \
  /home/dragos/learnin/yocto/poky/meta-yocto-bsp \
  /home/dragos/learnin/yocto/poky/meta-raspberrypi \
  /home/dragos/learnin/yocto/poky/meta-openembedded/meta-oe \
  /home/dragos/learnin/yocto/poky/meta-my-rpi-layer \
  /home/dragos/learnin/yocto/poky/meta-gps-mapserver \
  "
```

## yocto/meta-gps-mapserver/conf/layer.conf
```bitbake
# We have a conf and classes directory, add to BBPATH
BBPATH .= ":${LAYERDIR}"

# We have recipes-* directories, add to BBFILES
BBFILES += "${LAYERDIR}/recipes-*/*/*.bb \
            ${LAYERDIR}/recipes-*/*/*.bbappend"

BBFILE_COLLECTIONS += "meta-gps-mapserver"
BBFILE_PATTERN_meta-gps-mapserver = "^${LAYERDIR}/"
BBFILE_PRIORITY_meta-gps-mapserver = "1"

LAYERDEPENDS_meta-gps-mapserver = "core"
LAYERSERIES_COMPAT_meta-gps-mapserver = "kirkstone"

IMAGE_INSTALL:append = " server"
```
